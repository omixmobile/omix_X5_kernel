## drivers/input/fingerprint/Kconfig
```kconfig
#
#Fingerprint
#
menu "Fingerprint support"
	depends on INPUT

config MTK_FINGERPRINT_SUPPORT
	bool "Mediatek Fingerprint"
	default n
	help
	  Fingerprint mtk driver enable/disable
	  in the kernel.Say Y here if you want to
	  use mediatek fingerprint driver,fingerprint
	  driver will support fingerprint function

#Antai <AI_BSP_FP> <luobowen> <2021-05-26> add for fp begin	
config FOCALTECH_FINGERPRINT
	tristate "FocalTech FingerPrint"
	default n
   	help
		If you say Y to this option, support will be included for
		the FocalTech's fingerprint sensor. This driver supports
		both REE and TEE.

		This driver can also be built as a module. If so, the module
		will be called 'focaltech_fp'.
#Antai <AI_BSP_FP> <luobowen> <2021-05-26> add for fp end
config MTK_FINGERPRINT_SELECT
	string "sensor type"
	default "GF318M"


endmenu
```

## drivers/input/touchscreen/ai_tp/ilitek_spi_touch_driver/Kconfig
```kconfig
#
# Touchscreen driver configuration
#
	
config TOUCHSCREEN_MTK_ILITEK_SPI
		bool "ILITEK_SPI"
		depends on SPI
		help
			Say Y here if you have a Novatek ILITEK Panel
			to the host processor over SPI

			If unsure, say N.

#Antaiui <AI_BSP_CTP> <hehl> <2020-5-28> add gesture  start
config AI_BSP_GESTURE_SWITCH
		bool "ILITEK_SPI"
		depends on SPI
		help
			Say Y here if you have a Novatek ILITEK Panel
			to the host processor over SPI

			If unsure, say N.
#Antaiui <AI_BSP_CTP> <hehl> <2020-5-28> add gesture  end
```

## drivers/misc/mediatek/ai_device_check/Kconfig
```kconfig
config ANT_CAM_MAX_NUMBER_OF_CAMERA
    int "number of cameras"
    default 3
    help
        show camera num.
```
